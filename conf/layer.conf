## conf/layer.conf
```bitbake
# We have a conf and classes directory, add to BBPATH
BBPATH =. "${LAYERDIR}:"

# We have recipes-* directories, add to BBFILES
BBFILES += "${LAYERDIR}/recipes-*/*/*.bb \
            ${LAYERDIR}/recipes-*/*/*.bbappend"

BBFILE_COLLECTIONS += "andebian"
BBFILE_PATTERN_andebian = "^${LAYERDIR}/"
BBFILE_PRIORITY_andebian = "6"

LAYERSERIES_COMPAT_andebian = "rocko"

# This should only be incremented on significant changes that will
# cause compatibility issues with other layers
LAYERVERSION_andebian = "1"

LAYERDEPENDS_andebian = "yocto"

REQUIRED_POKY_BBLAYERS_CONF_VERSION = "2"
```
